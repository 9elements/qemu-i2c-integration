## br2-external/Config.in
```kconfig
source "$BR2_EXTERNAL_I2C_INTEGRATION_PATH/package/mctp-echo/Config.in"
source "$BR2_EXTERNAL_I2C_INTEGRATION_PATH/package/mctp-init/Config.in"
```

## br2-external/package/mctp-echo/Config.in
```kconfig
config BR2_PACKAGE_MCTP_ECHO
	bool "mctp-echo"
	help
	  Simple MCTP echo test application for i2c chardev testing.

	  Currently prints a hello world message.
```

## br2-external/package/mctp-init/Config.in
```kconfig
config BR2_PACKAGE_MCTP_INIT
	bool "mctp-init"
	help
	  MCTP initialization script for setting up I2C interfaces
	  and routing configuration at boot time.
```
